/ {
    kscan0: kscan {
        compatible = "zmk,kscan-gpio-direct";
        input-gpios
            = <&gpio0 0 (GPIO_ACTIVE_LOW | GPIO_PULL_UP)>
            , <&gpio0 1 (GPIO_ACTIVE_LOW | GPIO_PULL_UP)>
            ;
    };
};